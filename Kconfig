## Kconfig
```kconfig
menu "TCA9548A I2C Multiplexer"

    config TCA9548A_I2C_TIMEOUT_MS
        int "I2C command timeout in milliseconds"
        default 1000
        help
            Timeout for I2C master command in milliseconds.
endmenu
```
